## boards/arm/zx0/Kconfig.board
```kconfig
# ZX0 Board configuration

# Copyright (c) 2021 Google LLC.
# SPDX-License-Identifier: Apache-2.0

config BOARD_ZX0
	bool "ZX0"
	depends on SOC_PART_NUMBER_SAMD21E18A
```

## boards/arm/zx0/Kconfig.defconfig
```kconfig
# ZX0 board configuration

# Copyright (c) 2021 Google LLC.
# SPDX-License-Identifier: Apache-2.0

config BOARD
	default "zx0"
	depends on BOARD_ZX0
```

## boards/arm/zx0/zx0_defconfig
```kconfig
# SPDX-License-Identifier: Apache-2.0

CONFIG_SOC_SERIES_SAMD21=y
CONFIG_SOC_PART_NUMBER_SAMD21E18A=y
CONFIG_BOARD_ZX0=y
CONFIG_CORTEX_M_SYSTICK=y
CONFIG_CONSOLE=y
CONFIG_UART_CONSOLE=y
CONFIG_UART_INTERRUPT_DRIVEN=y
CONFIG_SERIAL=y
CONFIG_PINMUX=y
```
